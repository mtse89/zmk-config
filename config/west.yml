## config/west.yml
```yaml
manifest:
  remotes:
    - name: kylemccreery
      url-base: https://github.com/kylemccreery
  projects:
    - name: zmk
      remote: kylemccreery
      revision: murphpad
      import: app/west.yml
  self:
    path: config
```
